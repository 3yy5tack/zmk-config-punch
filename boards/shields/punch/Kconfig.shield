## boards/shields/punch/Kconfig.shield
```kconfig
config SHIELD_PUNCH_LEFT
    def_bool $(shields_list_contains,punch_left)

config SHIELD_PUNCH_RIGHT
    def_bool $(shields_list_contains,punch_right)
```

## boards/shields/woposh/Kconfig.defconfig
```kconfig
if SHIELD_PUNCH_LEFT

config ZMK_KEYBOARD_NAME
    default "punch"

config ZMK_SPLIT_ROLE_CENTRAL
    default y

endif # SHIELD_PUNCH_LEFT

if SHIELD_PUNCH_LEFT || SHIELD_PUNCH_RIGHT

config ZMK_SPLIT
    default y

endif # SHIELD_PUNCH_LEFT || SHIELD_PUNCH_RIGHT
```
